## Yocto-labs/builds/build-qemu/conf/bblayers.conf
```bitbake
# POKY_BBLAYERS_CONF_VERSION is increased each time build/conf/bblayers.conf
# changes incompatibly
POKY_BBLAYERS_CONF_VERSION = "2"

BBPATH = "${TOPDIR}"
BBFILES ?= ""

BBLAYERS ?= " \
  /home/link/Yocto-labs/layers/poky/meta \
  /home/link/Yocto-labs/layers/poky/meta-poky \
  /home/link/Yocto-labs/layers/poky/meta-yocto-bsp \
  /home/link/Yocto-labs/layers/meta-openembedded/meta-oe \
  /home/link/Yocto-labs/layers/meta-my-layer \
  "
```
